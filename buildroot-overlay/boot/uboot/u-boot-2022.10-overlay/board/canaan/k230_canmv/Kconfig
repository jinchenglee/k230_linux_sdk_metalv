## buildroot-overlay/boot/uboot/u-boot-2022.10-overlay/board/canaan/k230_canmv/Kconfig
```kconfig
if TARGET_K230_CANMV

config SYS_CPU
	default "k230"

config SYS_VENDOR
    default "canaan"

config SYS_BOARD
    default "k230_canmv"

config SYS_CONFIG_NAME
    default "k230_evb"


config BOARD_SPECIFIC_OPTIONS # dummy
	def_bool y
	select RISCV_THEAD

config LINUX_RUN_CORE_ID
	int "Linux boot core"
	range 0 1
	default 1
	help
	  Select the K230 SoC CPU slot that runs U-Boot and Linux. Slot 0 keeps
	  execution on the booted small core; slot 1 releases the big core and
	  parks the small core, preserving the vendor single-Linux behavior.

choice
	prompt "ddr typy freq"
    default CANMV_LPDDR3_2133

    config CANMV_LPDDR3_2133
        bool  "k230 canmv ddr3 2133"

    config CANMV_V3_LPDDR4_2667
	    bool "canmv v3 LP4_2667"
        help
            "CANMV V3,lushanpai,01studio"

    config CANMV_V3_LPDDR4_3200
	    bool "canmv v3 LP4_3200"
        help
            "CANMV V3,lushanpai,01studio"

    config CANMV_LPDDR4_1600_WITHOUT_ODT
	    bool "canmv  LP4_1600 WITHOUT ODT,"
        help
            "CANMV V3,lushanpai,01studio"
endchoice
endif
```

## buildroot-overlay/package/ai_demo/tinytag_detect/Config.in
```kconfig
config BR2_PACKAGE_TINYTAG_DETECT
    bool "tinytag_detect"
    select BR2_PACKAGE_GSL_LITE
    select BR2_PACKAGE_COMMON
    select BR2_PACKAGE_DISPLAY
    select BR2_PACKAGE_APRILTAG
    select BR2_PACKAGE_K230_OSD
    help
        AprilTag detector using a small neural network (TinyTag) to propose
        candidate tag ROIs, then the standard AprilTag C library to decode
        each ROI crop -- see experimental/tinytag-v4c and
        experimental/tinytag-v6 (HEADS_AND_POSTPROCESSING.md) in the repo
        root for the model and its training-side design notes.

        Only the trained heatmap/offset/scale channels (0-4 of the kmodel's
        21-channel output) are used; corner/visibility channels (5-20) are
        untrained and deliberately ignored.
```

## buildroot-overlay/package/apriltag/Config.in
```kconfig
config BR2_PACKAGE_APRILTAG
    bool "AprilTag C library"
    depends on BR2_TOOLCHAIN_HAS_THREADS
    help
        Official AprilRobotics AprilTag 3 detector library.

        https://github.com/AprilRobotics/apriltag
```

## buildroot-overlay/package/apriltag_demo/Config.in
```kconfig
config BR2_PACKAGE_APRILTAG_DEMO
    bool "apriltag live demo"
    depends on BR2_TOOLCHAIN_HAS_THREADS
    depends on BR2_TOOLCHAIN_HAS_SYNC_4
    depends on !BR2_STATIC_LIBS
    depends on BR2_USE_WCHAR
    select BR2_PACKAGE_DISPLAY
    select BR2_PACKAGE_OPENCV4
    select BR2_PACKAGE_LIBMMZ
    select BR2_PACKAGE_VVCAM
    select BR2_PACKAGE_APRILTAG
    select BR2_PACKAGE_ARUCO_NANO
    select BR2_PACKAGE_ARUCO2
    select BR2_PACKAGE_K230_OSD
    select BR2_PACKAGE_LINUX_TOOLS_PERF
    select BR2_PACKAGE_BINUTILS
    select BR2_PACKAGE_BINUTILS_TARGET
    help
        Three live on-device fiducial applications with identical camera,
        grayscale preprocessing, and DRM display paths:

        - apriltag_demo: the apriltag-rvv Rust detector
        - apriltag_c_demo: the official AprilRobotics C detector
        - aruco_demo: selectable ArUco Nano or ArUco2 detector, with
          strict and tolerant acceptance modes

        Target perf, objdump, and comparison/annotation scripts are installed
        alongside the applications for on-device profiling.

        The Rust static library must be built first in the rvv-dev docker
        image (package scripts/build_rust_lib.sh).
```

## buildroot-overlay/package/aruco2/Config.in
```kconfig
config BR2_PACKAGE_ARUCO2
	bool "aruco2"
	select BR2_PACKAGE_OPENCV4
	select BR2_PACKAGE_OPENCV4_LIB_IMGPROC
	help
	  Current standalone ArUco2 fiducial marker detector library.

	  https://github.com/rmsalinas/aruco2
```

## buildroot-overlay/package/aruco_nano/Config.in
```kconfig
config BR2_PACKAGE_ARUCO_NANO
	bool "aruco nano"
	select BR2_PACKAGE_OPENCV4
	select BR2_PACKAGE_OPENCV4_LIB_IMGPROC
	help
	  Header-only ArUco Nano fiducial marker detector.

	  https://github.com/rmsalinas/aruco_nano
```

## buildroot-overlay/package/isp_lcd_preview/Config.in
```kconfig
config BR2_PACKAGE_ISP_LCD_PREVIEW
    bool "isp_lcd_preview (universal camera preview)"
    depends on BR2_TOOLCHAIN_HAS_THREADS
    select BR2_PACKAGE_DISPLAY
    select BR2_PACKAGE_VVCAM
    help
      Standalone live camera preview for the K230 that works on any
      display/camera config and on either core (scalar or RVV).

      Auto-detects the display connector at runtime:
        - HDMI / landscape DSI: passthrough rectangle, no rotation.
        - Portrait DSI LCD (e.g. 480x800): landscape capture buffer sized
          from the panel, 90-degree rotation, explicit portrait destination.
      This replicates the confirmed-working portrait geometry from the
      apriltag/tinytag apps instead of the generic v4l2-drm CLI, which cannot
      decouple the portrait destination from the source buffer.

      It is a preview utility only: it does not touch the ISP daemon,
      tuning files, or any application code.
```

## buildroot-overlay/package/k230_amp_camera_pool/Config.in
```kconfig
config BR2_PACKAGE_K230_AMP_CAMERA_POOL
	bool "AMP reserved-memory shared DMA-BUF pool"
	depends on BR2_LINUX_KERNEL
	help
	  Allocate variable-size pinned buffers from a configurable no-map
	  AMP reserved-memory region and export them as DMA-BUF file
	  descriptors plus opaque remote-visible tokens. The K230 build uses
	  its AMP camera carveout as the first platform backend.
```

## buildroot-overlay/package/k230_amp_mailbox/Config.in
```kconfig
config BR2_PACKAGE_K230_AMP_MAILBOX
	bool "K230 AMP mailbox driver"
	depends on BR2_LINUX_KERNEL
	help
	  Build the minimal K230 mailbox notification driver used between
	  small-core Linux and the big-core Metal-V AMP payload.
```

## buildroot-overlay/package/k230_osd/Config.in
```kconfig
config BR2_PACKAGE_K230_OSD
    bool "k230 shared OSD overlay library"
    select BR2_PACKAGE_DISPLAY
    select BR2_PACKAGE_OPENCV4
    help
        Shared double-buffered ARGB OSD overlay for K230 camera/AI apps.
        One copy of the OSD plane buffer/swap/rotation plumbing that both
        apriltag_demo and tinytag_detect (and future apps) link, instead of
        each app carrying a divergence-prone duplicate. It owns the
        double-buffered FRONT/BACK OSD plane, the tear-free osd_disp_buffer
        swap, overlay generation gating, and the landscape / LCD-fastpath /
        rotate-fallback rotation; the app does its own drawing.

        See package/k230_osd/include/k230_osd.h for the lifecycle and the
        fast-detection (faster-than-vsync) clearing caveat.
```

## buildroot-overlay/package/metal_v_amp/Config.in
```kconfig
config BR2_PACKAGE_METAL_V_AMP
	bool "Metal-V K230 AMP console payload"
	depends on BR2_riscv && BR2_RISCV_64
	select BR2_PACKAGE_VVCAM
	select BR2_PACKAGE_LIBMMZ
	select BR2_PACKAGE_K230_AMP_CAMERA_POOL
	help
	  Build a freestanding RV64GCV diagnostic payload for the K230 big
	  core. It starts at 0x1c000000 and provides a polling UART3 console
	  on the second CH342 ACM channel.
```

## buildroot-overlay/package/nn_profile/Config.in
```kconfig
config BR2_PACKAGE_NN_PROFILE
    bool "generic neural-network profiler"
    depends on BR2_TOOLCHAIN_HAS_THREADS
    depends on !BR2_STATIC_LIBS
    select BR2_PACKAGE_LINUX_TOOLS_PERF
    help
        Generic Linux profiler for statically compiled neural-network
        plugins. It reports latency, throughput, work-normalized metrics,
        and available hardware performance counters.

        Model plugins are supplied separately so private model weights and
        kernel sources never enter this public SDK tree.
```

## buildroot-overlay/package/vvcam/Config.in
```kconfig
config BR2_PACKAGE_VVCAM
    bool "K230 ISP server"
    select BR2_PACKAGE_MXML
    select BR2_PACKAGE_LIBMICROHTTPD
    select BR2_PACKAGE_DISPLAY
    help
        K230 ISP server

config BR2_PACKAGE_VVCAM_USB_GADGET
    bool "ADB/MTP USB gadget support"
    depends on BR2_PACKAGE_VVCAM
    default y
    select BR2_PACKAGE_ANDROID_TOOLS
    select BR2_PACKAGE_UMTPRD
    help
        Install the ADB daemon and userspace MTP responder used by the
        optional USB gadget startup script. They are not required by the ISP.

config BR2_PACKAGE_VVCAM_DEF_SENSOR
    string "default sensor"
    default "ov5647"
```
